## arch/arm64/configs/defconfig
```kconfig
# CONFIG_LOCALVERSION_AUTO is not set
CONFIG_SYSVIPC=y
CONFIG_POSIX_MQUEUE=y
CONFIG_AUDIT=y
CONFIG_NO_HZ_IDLE=y
CONFIG_NO_HZ=y
CONFIG_HIGH_RES_TIMERS=y
CONFIG_BSD_PROCESS_ACCT=y
CONFIG_BSD_PROCESS_ACCT_V3=y
CONFIG_TASKSTATS=y
CONFIG_TASK_DELAY_ACCT=y
CONFIG_TASK_XACCT=y
CONFIG_TASK_IO_ACCOUNTING=y
CONFIG_IKCONFIG=y
CONFIG_IKCONFIG_PROC=y
CONFIG_LOG_BUF_SHIFT=14
# CONFIG_MEMCG is not set
# CONFIG_MEMCG_SWAP is not set
CONFIG_CGROUP_HUGETLB=y
# CONFIG_UTS_NS is not set
# CONFIG_IPC_NS is not set
# CONFIG_NET_NS is not set
CONFIG_SCHED_AUTOGROUP=y
CONFIG_BLK_DEV_INITRD=y
CONFIG_KALLSYMS_ALL=y
# CONFIG_COMPAT_BRK is not set
CONFIG_PROFILING=y
CONFIG_JUMP_LABEL=y
CONFIG_MODULES=y
CONFIG_MODULE_UNLOAD=y
# CONFIG_BLK_DEV_BSG is not set
# CONFIG_IOSCHED_DEADLINE is not set
# CONFIG_ARCH_VEXPRESS is not set
CONFIG_ARCH_MNH=y
CONFIG_PCI=n
CONFIG_ARM64_VA_BITS_48=y
CONFIG_SCHED_MC=y
CONFIG_PREEMPT=y
# CONFIG_KSM is not set
# CONFIG_TRANSPARENT_HUGEPAGE is not set
CONFIG_CMA=y
CONFIG_CMA_SIZE_MBYTES=128
CONFIG_CMA_AREAS=1
CONFIG_XEN=n
# CONFIG_CORE_DUMP_DEFAULT_ELF_HEADERS is not set
CONFIG_COMPAT=y
CONFIG_CPU_IDLE=y
CONFIG_ARM_CPUIDLE=y
CONFIG_CPU_FREQ=y
# CONFIG_ARM_BIG_LITTLE_CPUFREQ is not set
CONFIG_NET=n
CONFIG_UNIX=y
CONFIG_INET=n
CONFIG_UEVENT_HELPER_PATH="/sbin/hotplug"
CONFIG_DEVTMPFS=y
CONFIG_DEVTMPFS_MOUNT=y
CONFIG_DMA_CMA=y
CONFIG_MTD=y
CONFIG_MTD_SPI_NOR=y
CONFIG_BLK_DEV_LOOP=y
CONFIG_VIRTIO_BLK=y
# CONFIG_SCSI_PROC_FS is not set
CONFIG_BLK_DEV_SD=y
# CONFIG_SCSI_LOWLEVEL is not set
# CONFIG_ATA is not set
# CONFIG_NETDEVICES is not set
# CONFIG_INPUT is not set
# CONFIG_INPUT_KEYBOARD is not set
# CONFIG_INPUT_MOUSEDEV is not set
# CONFIG_INPUT_EVDEV is not set
CONFIG_SERIAL_8250=y
CONFIG_SERIAL_8250_CONSOLE=y
CONFIG_SERIAL_8250_DW=y
# CONFIG_SERIAL_8250_MT6577 is not set
# CONFIG_SERIAL_8250_UNIPHIER is not set
CONFIG_SERIAL_8250_NR_UARTS=2
CONFIG_SERIAL_8250_RUNTIME_UARTS=2
# CONFIG_SERIAL_AMBA_PL011 is not set
# CONFIG_SERIAL_AMBA_PL011_CONSOLE is not set
CONFIG_SERIAL_OF_PLATFORM=y
CONFIG_VIRTIO_CONSOLE=y
# CONFIG_HW_RANDOM is not set
CONFIG_I2C_CHARDEV=y
CONFIG_I2C_DESIGNWARE_PLATFORM=y
CONFIG_SPI=y
CONFIG_SPI_DESIGNWARE=y
CONFIG_SPI_DW_MMIO=y
CONFIG_SPI_SPIDEV=y
CONFIG_ARCH_WANT_OPTIONAL_GPIOLIB=y
CONFIG_ARCH_REQUIRE_GPIOLIB=y
CONFIG_GPIOLIB=y
CONFIG_GPIO_DEVRES=y
CONFIG_OF_GPIO=y
CONFIG_GPIO_SYSFS=y
CONFIG_GPIO_GENERIC=y
CONFIG_GPIO_DWAPB=y
CONFIG_THERMAL=y
# CONFIG_WATCHDOG is not set
# CONFIG_SOUND is not set
# CONFIG_SND is not set
# CONFIG_USB is not set
# CONFIG_USB_OTG is not set
# CONFIG_MMC is not set
CONFIG_RTC_CLASS=y
# CONFIG_RTC_DRV_PL031 is not set
CONFIG_DMADEVICES=y
CONFIG_TMPFS=y
CONFIG_DEBUG_INFO=y
CONFIG_DEBUG_FS=y
CONFIG_MAGIC_SYSRQ=y
CONFIG_DEBUG_KERNEL=y
CONFIG_LOCKUP_DETECTOR=n
# CONFIG_SCHED_DEBUG is not set
# CONFIG_DEBUG_PREEMPT is not set
# CONFIG_FTRACE is not set
CONFIG_MEMTEST=y
CONFIG_SECURITY=y
CONFIG_CRYPTO_ECHAINIV=y
CONFIG_CRYPTO_ANSI_CPRNG=y
CONFIG_ARM64_CRYPTO=y
CONFIG_CRYPTO_SHA1_ARM64_CE=y
CONFIG_CRYPTO_SHA2_ARM64_CE=y
CONFIG_CRYPTO_GHASH_ARM64_CE=y
CONFIG_CRYPTO_AES_ARM64_CE_CCM=y
CONFIG_CRYPTO_AES_ARM64_CE_BLK=y
CONFIG_CRYPTO_AES_ARM64_NEON_BLK=y
CONFIG_CRYPTO_CRC32_ARM64=y
# CONFIG_ARM_TIMER_SP804 is not set
CONFIG_STAGING=y
CONFIG_ANDROID=y
CONFIG_ION=y
# CONFIG_ION_DUMMY is not set
CONFIG_TIMER_STATS=y
CONFIG_COMMON_CLK_VERSATILE=y
CONFIG_PRINTK_TIME=y
CONFIG_DYNAMIC_DEBUG=y
CONFIG_MIPICSI_TOP=y
CONFIG_I2C=y
CONFIG_DMATEST=y
CONFIG_DW_DMAC_CORE=y
CONFIG_DW_DMAC=y
CONFIG_PAINTBOX=y
CONFIG_PAINTBOX_V1=y
CONFIG_PAINTBOX_TEST_SUPPORT=y
CONFIG_PROC_PCI_TEST_HELPER=y
CONFIG_MNH_FREQ_COOLING=y
CONFIG_HIBERNATION=y
CONFIG_MNH_SWAP=y
# CONFIG_UNIX98_PTYS is not set
# CONFIG_LEGACY_PTYS is not set
# CONFIG_LEGACY_PTY_COUNT is not set
# CONFIG_HID is not set
# CONFIG_INPUT_MOUSE is not set
# CONFIG_MOUSE_PS2 is not set
# CONFIG_SSB_POSSIBLE is not set
# CONFIG_BCMA_POSSIBLE is not set
# CONFIG_DUMMY_CONSOLE is not set
# CONFIG_EDAC_SUPPORT is not set
CONFIG_GOOGLE_EASEL=y
CONFIG_GOOGLE_EASEL_AP=n
CONFIG_MNH_THERMAL=y
CONFIG_ION_EASEL=y
CONFIG_IOMMU_SUPPORT=y
CONFIG_PAINTBOX_IOMMU=y
```

## arch/arm64/configs/mnh_defconfig
```kconfig
CONFIG_SYSVIPC=y
CONFIG_NO_HZ=y
CONFIG_HIGH_RES_TIMERS=y
CONFIG_BSD_PROCESS_ACCT=y
CONFIG_BSD_PROCESS_ACCT_V3=y
CONFIG_IKCONFIG=y
CONFIG_IKCONFIG_PROC=y
CONFIG_LOG_BUF_SHIFT=17
# CONFIG_UTS_NS is not set
# CONFIG_IPC_NS is not set
CONFIG_SCHED_AUTOGROUP=y
CONFIG_BLK_DEV_INITRD=y
CONFIG_KALLSYMS_ALL=y
# CONFIG_COMPAT_BRK is not set
CONFIG_PROFILING=y
CONFIG_JUMP_LABEL=y
CONFIG_MODULES=y
CONFIG_MODULE_UNLOAD=y
# CONFIG_BLK_DEV_BSG is not set
# CONFIG_IOSCHED_DEADLINE is not set
CONFIG_PROCFS_MOUNT=y
CONFIG_ARCH_MNH=y
CONFIG_ARM64_VA_BITS_48=y
CONFIG_SCHED_MC=y
CONFIG_PREEMPT=y
CONFIG_CMA=y
CONFIG_CMA_AREAS=1
# CONFIG_EFI is not set
# CONFIG_CORE_DUMP_DEFAULT_ELF_HEADERS is not set
CONFIG_COMPAT=y
CONFIG_SUSPEND_FREEZER=y
CONFIG_HIBERNATION=y
CONFIG_PM_AUTOSLEEP=y
CONFIG_CPU_IDLE=y
CONFIG_ARM_CPUIDLE=y
CONFIG_CPU_FREQ=y
CONFIG_UEVENT_HELPER_PATH="/sbin/hotplug"
CONFIG_DEVTMPFS=y
CONFIG_DEVTMPFS_MOUNT=y
CONFIG_DMA_CMA=y
CONFIG_CMA_SIZE_MBYTES=4
CONFIG_MTD=y
CONFIG_MTD_SPI_NOR=y
CONFIG_GOOGLE_EASEL=y
CONFIG_PAINTBOX=y
CONFIG_PAINTBOX_DEBUG=y
CONFIG_PAINTBOX_TEST_SUPPORT=y
# CONFIG_PAINTBOX_IOMMU_ENABLED is not set
# CONFIG_INPUT_MOUSEDEV is not set
# CONFIG_INPUT_KEYBOARD is not set
# CONFIG_INPUT_MOUSE is not set
# CONFIG_LEGACY_PTYS is not set
CONFIG_SERIAL_8250=y
CONFIG_SERIAL_8250_CONSOLE=y
CONFIG_SERIAL_8250_NR_UARTS=2
CONFIG_SERIAL_8250_RUNTIME_UARTS=2
CONFIG_SERIAL_8250_DW=y
CONFIG_SERIAL_OF_PLATFORM=y
# CONFIG_HW_RANDOM is not set
CONFIG_GPIOLIB=y
CONFIG_GPIO_SYSFS=y
CONFIG_GPIO_DWAPB=y
CONFIG_THERMAL=y
CONFIG_MNH_THERMAL=y
CONFIG_MNH_FREQ_COOLING=y
# CONFIG_HID is not set
CONFIG_RTC_CLASS=y
CONFIG_DMADEVICES=y
CONFIG_DMATEST=y
CONFIG_STAGING=y
CONFIG_ION=y
CONFIG_ION_EASEL=y
CONFIG_COMMON_CLK_VERSATILE=y
CONFIG_PAINTBOX_IOMMU=y
CONFIG_ANDROID=y
CONFIG_MNH_PCIE_EP_TEST=y
CONFIG_MIPICSI_TOP=y
CONFIG_PROC_PCI_TEST_HELPER=y
CONFIG_TMPFS=y
CONFIG_TMPFS_DEFAULT_SIZE_PERCENT_NR=80
CONFIG_NLS=y
CONFIG_PRINTK_TIME=y
CONFIG_DYNAMIC_DEBUG=y
CONFIG_DEBUG_INFO=y
CONFIG_DEBUG_FS=y
CONFIG_NET=y
CONFIG_UNIX=y
CONFIG_MAGIC_SYSRQ=y
CONFIG_DEBUG_KERNEL=y
# CONFIG_SCHED_DEBUG is not set
CONFIG_TIMER_STATS=y
# CONFIG_DEBUG_PREEMPT is not set
# CONFIG_FTRACE is not set
CONFIG_MEMTEST=y
CONFIG_SECURITY=y
# CONFIG_COMPILE_TEST=y
CONFIG_DW_APB_TIMER=y
CONFIG_DW_APB_TIMER_OF=y
```

## arch/arm64/configs/mnh_prod_defconfig
```kconfig
CONFIG_SYSVIPC=y
CONFIG_NO_HZ=y
CONFIG_HIGH_RES_TIMERS=y
# CONFIG_UTS_NS is not set
# CONFIG_IPC_NS is not set
CONFIG_SCHED_AUTOGROUP=y
CONFIG_BLK_DEV_INITRD=y
# CONFIG_COMPAT_BRK is not set
CONFIG_JUMP_LABEL=y
# CONFIG_BLK_DEV_BSG is not set
# CONFIG_IOSCHED_DEADLINE is not set
CONFIG_PROCFS_MOUNT=y
CONFIG_ARCH_MNH=y
CONFIG_ARM64_VA_BITS_48=y
CONFIG_SCHED_MC=y
CONFIG_PREEMPT=y
CONFIG_CMA=y
CONFIG_CMA_AREAS=1
# CONFIG_EFI is not set
# CONFIG_CORE_DUMP_DEFAULT_ELF_HEADERS is not set
CONFIG_COMPAT=y
CONFIG_PM_AUTOSLEEP=y
CONFIG_CPU_FREQ=y
CONFIG_NET=y
CONFIG_UNIX=y
# CONFIG_UEVENT_HELPER is not set
CONFIG_DEVTMPFS=y
CONFIG_DEVTMPFS_MOUNT=y
CONFIG_DMA_CMA=y
CONFIG_CMA_SIZE_MBYTES=4
# CONFIG_BLK_DEV is not set
CONFIG_GOOGLE_EASEL=y
CONFIG_PAINTBOX=y
# CONFIG_PAINTBOX_IOMMU_ENABLED is not set
# CONFIG_INPUT_MOUSEDEV is not set
# CONFIG_INPUT_KEYBOARD is not set
# CONFIG_INPUT_MOUSE is not set
# CONFIG_LEGACY_PTYS is not set
# CONFIG_HW_RANDOM is not set
CONFIG_GPIOLIB=y
CONFIG_GPIO_DWAPB=y
CONFIG_THERMAL=y
CONFIG_MNH_THERMAL=y
CONFIG_MNH_FREQ_COOLING=y
# CONFIG_HID is not set
CONFIG_STAGING=y
CONFIG_ION=y
CONFIG_ION_EASEL=y
CONFIG_COMMON_CLK_VERSATILE=y
CONFIG_DW_APB_TIMER_OF=y
CONFIG_PAINTBOX_IOMMU=y
CONFIG_ANDROID=y
CONFIG_TMPFS=y
CONFIG_TMPFS_DEFAULT_SIZE_PERCENT_NR=80
CONFIG_PRINTK_TIME=y
CONFIG_DEBUG_FS=y
```

## arch/arm64/configs/mnh_qemu_defconfig
```kconfig
CONFIG_SYSVIPC=y
CONFIG_NO_HZ=y
CONFIG_HIGH_RES_TIMERS=y
# CONFIG_UTS_NS is not set
# CONFIG_IPC_NS is not set
CONFIG_SCHED_AUTOGROUP=y
CONFIG_BLK_DEV_INITRD=y
CONFIG_KALLSYMS_ALL=y
# CONFIG_COMPAT_BRK is not set
CONFIG_JUMP_LABEL=y
# CONFIG_BLK_DEV_BSG is not set
# CONFIG_IOSCHED_DEADLINE is not set
CONFIG_PROCFS_MOUNT=y
CONFIG_ARCH_MNH=y
CONFIG_ARM64_VA_BITS_48=y
CONFIG_SCHED_MC=y
CONFIG_PREEMPT=y
CONFIG_CMA=y
CONFIG_CMA_AREAS=1
# CONFIG_EFI is not set
# CONFIG_CORE_DUMP_DEFAULT_ELF_HEADERS is not set
CONFIG_COMPAT=y
CONFIG_PM_AUTOSLEEP=y
CONFIG_CPU_FREQ=y
CONFIG_NET=y
CONFIG_UNIX=y
# CONFIG_UEVENT_HELPER is not set
CONFIG_DEVTMPFS=y
CONFIG_DEVTMPFS_MOUNT=y
CONFIG_DMA_CMA=y
CONFIG_CMA_SIZE_MBYTES=4
# CONFIG_BLK_DEV is not set
# CONFIG_GOOGLE_EASEL is not set (because there is no host to talk to)
CONFIG_PAINTBOX=y
CONFIG_PAINTBOX_DEBUG=y
CONFIG_PAINTBOX_TEST_SUPPORT=y
# CONFIG_PAINTBOX_IOMMU_ENABLED is not set
CONFIG_PAINTBOX_TEST_CMA=y
# CONFIG_INPUT_MOUSEDEV is not set
# CONFIG_INPUT_KEYBOARD is not set
# CONFIG_INPUT_MOUSE is not set
# CONFIG_LEGACY_PTYS is not set
# CONFIG_HW_RANDOM is not set
CONFIG_GPIOLIB=y
CONFIG_GPIO_DWAPB=y
CONFIG_THERMAL=y
CONFIG_MNH_THERMAL=y
CONFIG_MNH_FREQ_COOLING=y
# CONFIG_HID is not set
CONFIG_STAGING=y
CONFIG_ION=y
CONFIG_ION_EASEL=y
CONFIG_COMMON_CLK_VERSATILE=y
CONFIG_DW_APB_TIMER_OF=y
CONFIG_PAINTBOX_IOMMU=y
CONFIG_ANDROID=y
CONFIG_MNH_PCIE_EP_TEST=y
# CONFIG_MNH_PCIE_BOOT_TRACE is not set (hangs startup)
CONFIG_MNH_PCIE_EP=y
CONFIG_TMPFS=y
CONFIG_TMPFS_DEFAULT_SIZE_PERCENT_NR=80
CONFIG_PRINTK_TIME=y
CONFIG_DYNAMIC_DEBUG=y
CONFIG_DEBUG_INFO=y
CONFIG_DEBUG_FS=y
CONFIG_MAGIC_SYSRQ=y

# Some good kernel debugging configs (might want to add to mnh_defconfig)
CONFIG_DEBUG_KERNEL=y
CONFIG_MEMTEST=y
CONFIG_GDB_SCRIPTS=y
CONFIG_FRAME_POINTER=y

# These config options were brought over from the elinux emulator
# CONFIG_PAINTBOX_FPGA_SUPPORT=y
# CONFIG_PAINTBOX_FPGA_SOFT_RESET=y
CONFIG_PAINTBOX_TEST_SUPPORT=y
# CONFIG_PAINTBOX_IOMMU_ENABLED is not set
CONFIG_PAINTBOX_V0=y

# VM related config options
CONFIG_VIRTIO=y
CONFIG_VIRTIO_BLK=y
CONFIG_VIRTIO_MMIO=y
CONFIG_NET_9P=y
CONFIG_NET_9P_VIRTIO=y
CONFIG_NET_9P_DEBUG=y
CONFIG_9P_FS=y
CONFIG_9P_FS_POSIX_ACL=y
CONFIG_CMDLINE="console=ttyAMA0"
CONFIG_SERIO_AMBAKMI=y
# CONFIG_DEVKMEM is not set
CONFIG_SERIAL_AMBA_PL011=y
CONFIG_SERIAL_AMBA_PL011_CONSOLE=y
CONFIG_INET=y
```

## drivers/block/mnh-swap/Kconfig
```kconfig
config MNH_SWAP
        tristate "MNH Swap partition for hibernation support using PCIe outbound region"        
	default y
        ---help---
	    This block driver is used to read and write data to the PCIe outbound region.
```

## drivers/mipicsi/Kconfig
```kconfig
config MIPICSI_TOP
	tristate "Intel MIPI CSI TOP Driver"
	default n
	help
	  Intel MIPI Top Controller for Designware Rx/Tx
```

## drivers/misc/paintbox/Kconfig
```kconfig
#
# Paintbox Programmable IPU
#

menu "Paintbox Programmable IPU"

config PAINTBOX
	tristate "Paintbox programmable ISP"
	help
	  Say Y here if you want to support the Paintbox programmable ISP

config PAINTBOX_FPGA_SUPPORT
	bool  "Paintbox FPGA Support"
	depends on PAINTBOX
	default n
	---help---
	This option enables support for the Paintbox FPGA hardware.
	If you are unsure, say N.

config PAINTBOX_FPGA_SOFT_RESET
	bool  "Paintbox FPGA Soft Reset Support"
	depends on PAINTBOX_FPGA_SUPPORT
	default n
	---help---
	This option enables support for the FPGA soft reset register.
	If you are unsure, say N.

config PAINTBOX_SIMULATOR_SUPPORT
	bool  "Paintbox Simulator Support"
	depends on PAINTBOX
	default n
	---help---
	This option enables support for the Paintbox Simulator.
	If you are unsure, say N.

config PAINTBOX_TEST_SUPPORT
	bool  "Paintbox Test Support"
	depends on PAINTBOX
	default n
	---help---
	This option enables support for Paintbox test only ioctls.
	If you are unsure, say N.

config PAINTBOX_V1
	bool  "Paintbox V1 functionality and errata"
	depends on PAINTBOX
	default n
	---help---
	This option enables Paintbox V1 specific functionality and errata.
	If you are unsure, say N.

endmenu
```

## drivers/misc/paintbox_cma/Kconfig
```kconfig
#
# PAINTBOX CMA
#

config PAINTBOX_TEST_CMA
tristate "Paintbox CMA buffer management driver for register trace test purpose"
default n
```

## drivers/pcie_ep/Kconfig
```kconfig
#
# PCI Express Endpoint Configuration
#

config MNH_PCIE_EP
	def_bool n
	help
	  Enables the PCIe Endpoint driver

config MNH_PCIE_EP_TEST
	depends on MNH_PCIE_EP
	tristate "MNH PCIe Endpoint Test Module"
	default n
	help
	  Enables the PCIe Endpoint driver test module

config MNH_PCIE_MULTIPLE_MSI
	def_bool n
	help
	  Enables PCIE multiple MSI supports

config MNH_PCIE_BOOT_TRACE
	depends on MNH_PCIE_EP
	tristate "MNH Boot Status Tracker"
	default n
	help
	  Enables MNH boot status tracking via SCU register
```

## drivers/perfmon/Kconfig
```kconfig
#
# Performance MonitorConfiguration
#

config MNH_PERF_MON
	def_bool n
	help
	  Enables the Performance Monitor driver
```
